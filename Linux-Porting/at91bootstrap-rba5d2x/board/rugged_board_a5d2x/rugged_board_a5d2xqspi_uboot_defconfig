## Linux-Porting/at91bootstrap-rba5d2x/board/rugged_board_a5d2x/rugged_board_a5d2xqspi_uboot_defconfig
```kconfig
CONFIG_RUGGED_BOARD_A5D2X=y
CONFIG_RAM_64MB=y
CONFIG_SPI_CLK=66000000
CONFIG_QSPI=y
CONFIG_QSPI_BUS1=y
CONFIG_QSPI1_IOSET_2=y
CONFIG_IMG_ADDRESS="0x00020000"
CONFIG_JUMP_ADDR="0x22000000"
CONFIG_IMG_SIZE="0x00080000"
CONFIG_DEBUG=y
# CONFIG_ENTER_NWD is not set
```

## Linux-Porting/at91bootstrap-rba5d2x/board/rugged_board_a5d2x/rugged_board_a5d2xsd1_uboot_defconfig
```kconfig
CONFIG_RUGGED_BOARD_A5D2X=y
CONFIG_RAM_64MB=y
CONFIG_SDCARD=y
CONFIG_SDHC1=y
CONFIG_JUMP_ADDR="0x22000000"
CONFIG_DEBUG=y
# CONFIG_ENTER_NWD is not set
```
